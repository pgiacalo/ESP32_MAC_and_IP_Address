## sdkconfig.defaults
```kconfig
# ESP32 MAC and IP Address Library - Default Configuration

# Enable WiFi
CONFIG_ESP32_WIFI_ENABLED=y
CONFIG_ESP32_WIFI_STATIC_RX_BUFFER_NUM=10
CONFIG_ESP32_WIFI_DYNAMIC_RX_BUFFER_NUM=32
CONFIG_ESP32_WIFI_DYNAMIC_TX_BUFFER_NUM=32

# Enable networking
CONFIG_LWIP_IPV4=y
CONFIG_LWIP_IPV6=n

# Enable NVS Flash
CONFIG_NVS_ENABLED=y

# Enable event loop
CONFIG_ESP_EVENT_LOOP_PROFILING=y

# Logging configuration
CONFIG_LOG_DEFAULT_LEVEL_INFO=y
CONFIG_LOG_DEFAULT_LEVEL=3

# FreeRTOS configuration
CONFIG_FREERTOS_HZ=1000

# Memory configuration
CONFIG_SPIRAM_SUPPORT=y
CONFIG_SPIRAM_USE_MALLOC=y

# Component configuration
CONFIG_ESP_WIFI_ENABLED=y
CONFIG_ESP_NETIF_ENABLED=y
```
